## package/uvc-gadget/Config.in
```kconfig
config BR2_PACKAGE_UVC_GADGET
	bool "Raspberry Pi UVC Webcam"
	select BR2_PACKAGE_LIBV4L_UTILS
	help
	  Install Raspberry Pi UVC Webcam package

	  https://github.com/calebccff/uvc-gadget
```
